## main/Kconfig.projbuild
```kconfig
menu "SBUS Receiver Options"

config SBUS_UART_RX_GPIO
    int "SBUS UART RX GPIO"
    range 0 48
    default 1
    help
      GPIO number used for SBUS inverted UART RX.
      Default 1. Change to match your wiring.

endmenu
```

## sdkconfig.defaults
```kconfig
# CI/default configuration to ensure TinyUSB CDC + HID enabled

CONFIG_TINYUSB_DESC_USE_ESPRESSIF_VID=y
CONFIG_TINYUSB_DESC_USE_DEFAULT_PID=y
CONFIG_TINYUSB_CDC_ENABLED=y
CONFIG_TINYUSB_CDC_COUNT=1
CONFIG_TINYUSB_HID_COUNT=1
CONFIG_TINYUSB_DEBUG_LEVEL=0
```
